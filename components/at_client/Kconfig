## components/at_client/Kconfig
```kconfig
menu "AT client"

    config AT_CLIENT_TASK_STACK
        int "Modem task stack (bytes)"
        default 4096

    config AT_CLIENT_TASK_PRIO
        int "Modem task priority"
        default 5

    config AT_CLIENT_QUEUE_DEPTH
        int "Command queue depth"
        range 1 8
        default 4

    config AT_CLIENT_DEFAULT_TIMEOUT_MS
        int "Default command timeout (ms)"
        default 3000

    config AT_CLIENT_MAX_LINE_LEN
        int "Max single line length (bytes)"
        default 256

    config AT_CLIENT_MAX_AGG_LEN
        int "Max aggregated response before OK/ERROR (bytes)"
        default 512

    config AT_CLIENT_DEFAULT_RETRIES
        int "Default retries on timeout/fail"
        range 0 5
        default 2

endmenu
```

## components/modem_uart/Kconfig
```kconfig
menu "Modem UART transport"

    config MODEM_UART_PORT_NUM
        int "UART port number (ESP32: 0-2)"
        range 0 2
        default 2
        help
            UART controller connected to the modem (e.g. UART2 on DevKitC).

    config MODEM_UART_TX_GPIO
        int "TX GPIO (ESP32 -> modem RX)"
        range -1 48
        default 17
        help
            Set to -1 only for unusual wiring; default matches many DevKitC + modem shields.

    config MODEM_UART_RX_GPIO
        int "RX GPIO (modem TX -> ESP32)"
        range -1 48
        default 16

    config MODEM_UART_BAUD_RATE
        int "Baud rate"
        default 115200

    config MODEM_UART_RX_BUF_SIZE
        int "UART RX ring buffer size (bytes)"
        default 4096

    config MODEM_UART_TX_BUF_SIZE
        int "UART TX ring buffer size (bytes, 0 = minimal)"
        default 0

    config MODEM_PWRKEY_ENABLE
        bool "Drive modem PWRKEY from GPIO"
        default n
        help
            Pulse PWRKEY low/high per board schematic to power-cycle the modem.

    config MODEM_PWRKEY_GPIO
        int "PWRKEY GPIO (active level below)"
        depends on MODEM_PWRKEY_ENABLE
        range 0 48
        default 4

    config MODEM_PWRKEY_ACTIVE_LOW
        bool "PWRKEY is active low"
        depends on MODEM_PWRKEY_ENABLE
        default y

endmenu
```

## components/sim7000/Kconfig
```kconfig
menu "SIM7000 modem"

    config SIM7000_DEFAULT_APN
        string "Default APN (used if NVS key modem/apn is unset)"
        default "internet"
        help
            Stored APN in NVS overrides this. Set your carrier APN for automatic PDP.

    config SIM7000_BRINGUP_PDP
        bool "Attach PDP context during sim7000_bringup()"
        default y
        help
            If disabled, only SIM + registration checks run (useful for UART-only lab).

    config SIM7000_PDP_CID
        int "PDP context id (CID)"
        range 1 16
        default 1

    config SIM7000_BRINGUP_USE_CGACT
        bool "Send AT+CGACT=1 after CGDCONT during bring-up"
        default n
        depends on SIM7000_BRINGUP_PDP
        help
            When off (default), bring-up only programs the APN with AT+CGDCONT; esp_modem then runs
            its own CGDCONT and ATD*99# for PPP. On some SIM7xxx/LTE networks, pre-activating with
            CGACT=1 leaves the context busy and PPP drops before IPCP (no IP). Enable this if your
            carrier requires explicit activation before the dial.

    config SIM7000_AT_TIMEOUT_MS
        int "esp_modem AT command timeout in sim7000_bringup() (ms)"
        default 3000

    config SIM7000_AT_RESP_MAX_LEN
        int "Max aggregated AT response buffer (bytes) in sim7000_bringup()"
        range 256 2048
        default 512

    config SIM7000_WAIT_FOR_REGISTRATION
        bool "Wait for network registration before PPP data mode"
        default y
        help
            When the ESP32 and modem power up together, the SIM can take tens of seconds to
            register while the MCU is already running AT + PPP. If PPP starts while CREG/CEREG
            still show \"searching\" (stat 2), LCP/IPCP often times out. This option polls
            AT+CREG? / AT+CGREG? / AT+CEREG? until stat is registered (1 or 5) or the timeout
            below is reached.

    config SIM7000_REGISTRATION_POLL_MS
        int "Registration poll interval (ms)"
        depends on SIM7000_WAIT_FOR_REGISTRATION
        default 3000
        range 1000 60000

    config SIM7000_REGISTRATION_TIMEOUT_MS
        int "Max wait for registration before PPP (ms)"
        depends on SIM7000_WAIT_FOR_REGISTRATION
        default 120000
        range 10000 600000

endmenu
```

## main/Kconfig.projbuild
```kconfig
menu "Application"

    config APP_ENABLE_CELLULAR
        bool "Enable SIM7000 cellular (modem UART + PPP)"
        default n
        depends on LWIP_PPP_SUPPORT
        help
            When disabled, esp_modem, PPP, and SIM bring-up are skipped (Wi-Fi lab SNTP can still run).
            Enable this for field use with the modem. Requires Component config -> LWIP -> Enable PPP support.

endmenu

menu "Readings API (HTTP upload)"

    config READINGS_UPLOAD_ENABLE
        bool "POST /data once after IP (PPP or Wi-Fi)"
        default y
        help
            After the device has routed internet: one HTTPS POST with JSON {device_id, value} to
            <base>/data. Requires NVS key readings/api_key.
            With cellular on: runs after PPP gets an IP. With cellular off: uses Wi-Fi STA — either
            together with Lab Wi-Fi SNTP (same SSID) or Readings Wi-Fi SSID/password below.

    config READINGS_WIFI_SSID
        string "Wi-Fi SSID (readings when cellular off, no lab SNTP)"
        depends on READINGS_UPLOAD_ENABLE
        default ""
        help
            Used only when Application -> Enable SIM7000 cellular is OFF and Lab Wi-Fi SNTP is OFF.
            Set to your AP SSID for HTTPS upload over Wi-Fi. If Lab Wi-Fi SNTP is enabled, lab SSID
            is used instead (leave this empty).

    config READINGS_WIFI_PASSWORD
        string "Wi-Fi password (readings STA)"
        depends on READINGS_UPLOAD_ENABLE
        default ""
        help
            WPA/WPA2 PSK; empty for open networks. Same scope as READINGS_WIFI_SSID.

    config READINGS_WIFI_CONNECT_TIMEOUT_MS
        int "Wi-Fi connect timeout for readings STA (ms)"
        depends on READINGS_UPLOAD_ENABLE
        default 30000
        range 5000 120000

    config READINGS_API_BASE_URL
        string "Default API base URL (https://host, no path; optional trailing slash)"
        default "https://api.bedrocklabs.online"
        depends on READINGS_UPLOAD_ENABLE
        help
            Full POST URL is this value with "/data" appended. NVS key readings/api_base overrides
            when set.

    config READINGS_DEVICE_ID
        string "Default device_id in JSON body"
        default "esp32-001"
        depends on READINGS_UPLOAD_ENABLE
        help
            Must be 1-255 characters after trim; use letters, numbers, hyphen. NVS readings/device_id
            overrides when set.

    config READINGS_HTTP_TIMEOUT_MS
        int "HTTPS client timeout (ms)"
        depends on READINGS_UPLOAD_ENABLE
        default 60000
        range 5000 120000

    config READINGS_PROVISION_API_KEY_ON_BOOT
        bool "One-shot: write API key from the string below into NVS on boot"
        default n
        depends on READINGS_UPLOAD_ENABLE
        help
            When enabled, after nvs_flash_init the firmware calls readings_config_save_api_key()
            with READINGS_PROVISION_API_KEY_VALUE. Flash once, confirm NVS, then turn this OFF
            so the key is not rebuilt into every image. Do not commit sdkconfig if it contains
            a non-empty key string.

    config READINGS_PROVISION_API_KEY_VALUE
        string "API key to write to NVS (readings/api_key)"
        default ""
        depends on READINGS_PROVISION_API_KEY_ON_BOOT
        help
            Same value as server API_KEY. Leave empty when provisioning is disabled.

endmenu

menu "Lab: Wi-Fi time sync (SNTP)"

    config LAB_WIFI_SNTP
        bool "Connect Wi-Fi at boot, SNTP sync, then disconnect (before cellular / readings upload)"
        default n
        help
            Lab / development only. Brings up Wi-Fi STA, waits for SNTP to set system time,
            applies LAB_TZ_POSIX for localtime(), then stops Wi-Fi. Runs before modem PPP when
            cellular is on. If cellular is off and Readings upload is on, upload runs on this STA
            before disconnect. Do not enable in production unless intended.

    config LAB_WIFI_SSID
        string "Wi-Fi SSID"
        depends on LAB_WIFI_SNTP
        default "myssid"
        help
            STA SSID. Do not commit sdkconfig with your real SSID if the tree is public.

    config LAB_WIFI_PASSWORD
        string "Wi-Fi password"
        depends on LAB_WIFI_SNTP
        default ""
        help
            WPA/WPA2 PSK password; leave empty for open networks. Same hygiene as SSID.

    config LAB_WIFI_SNTP_SERVER
        string "NTP server hostname"
        depends on LAB_WIFI_SNTP
        default "pool.ntp.org"

    config LAB_WIFI_CONNECT_TIMEOUT_MS
        int "Wi-Fi connect timeout (ms)"
        depends on LAB_WIFI_SNTP
        default 30000
        range 5000 120000

    config LAB_SNTP_SYNC_TIMEOUT_MS
        int "SNTP sync wait timeout (ms)"
        depends on LAB_WIFI_SNTP
        default 60000
        range 10000 300000
        help
            lwIP may apply a random SNTP startup delay (Component config -> LWIP -> SNTP).
            Use a generous timeout here, or reduce/disable the startup delay for faster lab sync.

    config LAB_TZ_POSIX
        string "POSIX TZ string (CET/CEST)"
        depends on LAB_WIFI_SNTP
        default "CET-1CEST,M3.5.0/2,M10.5.0/3"
        help
            Passed to setenv(\"TZ\", ...); tzset(). Example is Central European Time with EU DST rules.

endmenu
```
